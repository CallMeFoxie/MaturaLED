/*
 * commands.asm
 *
 *  Created: 16.2.2012 17:02:49
 *   Author: Ondra
 */ 

COMMAND_WHO:
	PC_Send_String	STR_WHO
	RET

COMMAND_GPU_RESET:
	LDI		XL, LOW(BUFFER0)
	LDI		XH, HIGH(BUFFER0)
	LDI		R16, 0x00
COMMAND_GPU_RESET_LOOP:
	ST		X+, R16
	CPI16	XH, XL, 0x00, 0x00
	BREQ	COMMAND_GPU_RESET_DONE
	RJMP	COMMAND_GPU_RESET_LOOP
COMMAND_GPU_RESET_DONE:
	RET

// COMMAND_GPU DIRECT WRITE -- writes all 1.5kB of data in bulk.
COMMAND_GPU_DW:
	LDI		XL, LOW(BUFFER0)
	LDI		XH, HIGH(BUFFER0)
COMMAND_GPU_DW_LOOP:
	RCALL	PC_Receive
	ST		X+, R16
	CPI16	XH, XL, 0xE0, 0x00
	BREQ	COMMAND_GPU_DW_DONE
	RJMP	COMMAND_GPU_DW_LOOP
COMMAND_GPU_DW_DONE:
	RET

COMMAND_GPU_DR:
	LDI		XL, LOW(BUFFER0)
	LDI		XH, HIGH(BUFFER0)
COMMAND_GPU_DR_LOOP:
	LD		R16, X+
	RCALL	PC_Send
	CPI16	XH, XL, 0xE0, 0x00
	BREQ	COMMAND_GPU_DR_DONE
	RJMP	COMMAND_GPU_DR_LOOP
COMMAND_GPU_DR_DONE:
	RET


COMMAND_BRIGHTNESS:
	RCALL	PC_Receive
	OUT		OCR0, R16
	RET

COMMAND_JTAG:
	; disable JTD bit
	LDI		R16, 0x00
	OUT		MCUCSR, R16
	OUT		MCUCSR, R16
	; disable output to display aswell
	SBI		PortB, PB7
	RET

COMMAND_BIN_ADDR:
	; load two bytes
	RCALL	PC_Receive
	MOV		XH, R16

	RCALL	PC_Receive
	MOV		XL, R16

	CPI16	XH, XL, 0xC0, 0x00
	BRGE	COMMAND_BIN_ADDR_DONE
	TST		R9
	BRNE	COMMAND_BIN_ADDR_DONE
	LDI		XL, 0xC0
	LDI		XH, 0x00
COMMAND_BIN_ADDR_DONE:
	RET

COMMAND_BIN_BUFFER:
	RCALL	PC_Receive
	TST		R16
	BRNE	COMMAND_BIN_BUFFER_ONE
	MOV		R_NBUFFER, R16
	RET
COMMAND_BIN_BUFFER_ONE:
	LDI		R16, 0x01
	MOV		R_NBUFFER, R16
	RET


COMMAND_SETV:
	RCALL	PC_Receive
	CPI		R16, 16
	BRGE	COMMAND_SETV_FAIL
	MOV		R_MAXVIEW, R16
COMMAND_SETV_FAIL:
	RET

COMMAND_ADDR:
	LDI		XL, LOW(ADDRLD)
	LDI		XH, HIGH(ADDRLD)
	LDI		R18, 2
	RCALL	PC_LOADBINARY
	LDI		ZL, LOW(ADDRLD)
	LDI		ZH, HIGH(ADDRLD)
	LD		XH, Z+ ; first read HIGH byte
	LD		XL, Z
	CPI16	XH, XL, 0xC0, 0x00
	BRGE	COMMAND_ADDR_END
	TST		R9
	BRNE	COMMAND_ADDR_END
	LDI		XL, 0xC0
	LDI		XH, 0x00
COMMAND_ADDR_END:
	RET

COMMAND_LDPASS:
	RCALL	PC_Receive
	CPI		R16, SU_PASS
	BREQ	B_COMMAND_LDPASS_OK
	LDI		R16, 0x00
	RCALL	PC_Send
	MOV		R9, R16
	RJMP	LOOP
B_COMMAND_LDPASS_OK:
	LDI		R16, 0x01
	RCALL	PC_Send
	MOV		R9, R16
	RET


COMMAND_BIN_CWRITE:
	RCALL	PC_Receive
	MOV		XH, R16

	RCALL	PC_Receive
	MOV		XL, R16
	CPI16	XH, XL, 0xC0, 0x00 ; min address range set (GPU RAM offset)
	BRGE	COMMAND_BIN_CWRITE_SET
	RJMP	COMMAND_BIN_CWRITE_DONE

COMMAND_BIN_CWRITE_SET:
; now load the length of data (2 bytes)
	PUSH	YH
	PUSH	YL

	RCALL	PC_Receive
	MOV		YH, R16
	RCALL	PC_Receive
	MOV		YL, R16

	CPI16	YH, YL, 0x40, 0x00
	BRGE	COMMAND_BIN_CWRITE_FINISH ; overflow test
	;ADIW	Y, 1 ; off by one error

COMMAND_BIN_CWRITE_LOOP:
	RCALL	PC_Receive
	ST		X+, R16
	SBIW	Y, 1
	BREQ	COMMAND_BIN_CWRITE_FINISH
	RJMP	COMMAND_BIN_CWRITE_LOOP

COMMAND_BIN_CWRITE_FINISH:
	POP		YL
	POP		YH

COMMAND_BIN_CWRITE_DONE:
	RET